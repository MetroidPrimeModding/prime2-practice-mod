/* Template: carveouts.py fills in the @CARVEOUT_*@ placeholders from carveouts.json. */
ENTRY(_prolog)
EXTERN(_earlyboot_memset)
PHDRS
{
@CARVEOUT_PHDRS@
  maindata PT_LOAD;
  embedded_data PT_NOTE;
}

SECTIONS
{
  .patcher_config : {
    KEEP(*(.patcher_config*))
  } : embedded_data

  .new_bnr : {
      KEEP(*(.new_bnr*))
    } : embedded_data

  /* Carveout sections must come before maindata: an input section goes to the first rule that matches it. */
@CARVEOUT_SECTIONS@

  ASSERT((_LINK_START % 32) == 0, "maindata start must be DMA aligned")
  . = _LINK_START;
  .text :
  {
    _INIT_START = .;
    . = ALIGN(4);
    KEEP(*(.boot._prolog*))
    KEEP(*(.boot._earlyboot_memset*))
    KEEP(*(.boot*))
    *(.init)
    *(.text._prolog)
    *(.text*)
    *(.text.*)
    *(.gnu.warning)
    *(.gnu.linkonce.t*)
    *(.glue_7)
    *(.glue_7t)
  } :maindata

  .init_array :
  {
    KEEP(*(.init_array*))
  } :maindata

  .bss :
  {
    *(.dynbss)
    *(.gnu.linkonce.b*)
    *(.bss*)
    *(COMMON)
    . = ALIGN(4);
  } :maindata

  /* A file-backed section after BSS materializes its zero bytes in PT_LOAD for cold boot and DMA reload. */
  .data :
    {
      . = ALIGN(4);
      *(.rodata)
      *(.eh_frame)
      *all.rodata*(*)
      *(.roda)
      *(.rodata.*)
      *(.gnu.linkonce.r*)
      *(.data)
      *(.data.*)
      *(.gnu.linkonce.d*)
      /* 32-byte segment end: see Carveout.load_start in carveouts.py */
      . = ALIGN(32);
    } :maindata
  ASSERT((. % 32) == 0, "maindata end must be DMA aligned")
  ASSERT(. <= 0x81800000, "maindata exceeds MEM1")
  _LINK_END = .;
  _LINK_SIZE = _LINK_END - _LINK_START;
}
